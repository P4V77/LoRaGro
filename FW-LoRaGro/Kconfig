## FW-LoRaGro/twister-out/native_sim_native/host/sensors/soil_capacitive_adapter.basic/Kconfig/soc/Kconfig
```kconfig
# Load Zephyr SoC Kconfig descriptions.
osource "/home/pavel/.zephyr_ide/external/zephyr/soc/xlnx/zynqmp/Kconfig"
osource "/home/pavel/.zephyr_ide/external/zephyr/soc/xlnx/zynq7000/Kconfig"
osource "/home/pavel/.zephyr_ide/external/zephyr/soc/xlnx/versalnet/Kconfig"
osource "/home/pavel/.zephyr_ide/external/zephyr/soc/xlnx/versal2/Kconfig"
osource "/home/pavel/.zephyr_ide/external/zephyr/soc/xen/Kconfig"
osource "/home/pavel/.zephyr_ide/external/zephyr/soc/wch/ch32v/Kconfig"
osource "/home/pavel/.zephyr_ide/external/zephyr/soc/ti/simplelink/Kconfig"
osource "/home/pavel/.zephyr_ide/external/zephyr/soc/ti/mspm0/Kconfig"
osource "/home/pavel/.zephyr_ide/external/zephyr/soc/ti/lm3s6965/Kconfig"
osource "/home/pavel/.zephyr_ide/external/zephyr/soc/ti/k3/Kconfig"
osource "/home/pavel/.zephyr_ide/external/zephyr/soc/telink/tlsr/Kconfig"
osource "/home/pavel/.zephyr_ide/external/zephyr/soc/starfive/jh71xx/Kconfig"
osource "/home/pavel/.zephyr_ide/external/zephyr/soc/st/stm32/Kconfig"
osource "/home/pavel/.zephyr_ide/external/zephyr/soc/snps/qemu_arc/Kconfig"
osource "/home/pavel/.zephyr_ide/external/zephyr/soc/snps/nsim/arc_v/Kconfig"
osource "/home/pavel/.zephyr_ide/external/zephyr/soc/snps/nsim/arc_classic/Kconfig"
osource "/home/pavel/.zephyr_ide/external/zephyr/soc/snps/hsdk4xd/Kconfig"
osource "/home/pavel/.zephyr_ide/external/zephyr/soc/snps/hsdk/Kconfig"
osource "/home/pavel/.zephyr_ide/external/zephyr/soc/snps/emsk/Kconfig"
osource "/home/pavel/.zephyr_ide/external/zephyr/soc/snps/emsdp/Kconfig"
osource "/home/pavel/.zephyr_ide/external/zephyr/soc/snps/arc_iot/Kconfig"
osource "/home/pavel/.zephyr_ide/external/zephyr/soc/silabs/Kconfig"
osource "/home/pavel/.zephyr_ide/external/zephyr/soc/sifive/sifive_freedom/Kconfig"
osource "/home/pavel/.zephyr_ide/external/zephyr/soc/sensry/Kconfig"
osource "/home/pavel/.zephyr_ide/external/zephyr/soc/rockchip/Kconfig"
osource "/home/pavel/.zephyr_ide/external/zephyr/soc/renode/riscv_virtual/Kconfig"
osource "/home/pavel/.zephyr_ide/external/zephyr/soc/renode/cortex_r8_virtual/Kconfig"
osource "/home/pavel/.zephyr_ide/external/zephyr/soc/renesas/smartbond/Kconfig"
osource "/home/pavel/.zephyr_ide/external/zephyr/soc/renesas/rz/Kconfig"
osource "/home/pavel/.zephyr_ide/external/zephyr/soc/renesas/rx/Kconfig"
osource "/home/pavel/.zephyr_ide/external/zephyr/soc/renesas/rcar/Kconfig"
osource "/home/pavel/.zephyr_ide/external/zephyr/soc/renesas/ra/Kconfig"
osource "/home/pavel/.zephyr_ide/external/zephyr/soc/realtek/ec/Kconfig"
osource "/home/pavel/.zephyr_ide/external/zephyr/soc/raspberrypi/rpi_pico/Kconfig"
osource "/home/pavel/.zephyr_ide/external/zephyr/soc/quicklogic/eos_s3/Kconfig"
osource "/home/pavel/.zephyr_ide/external/zephyr/soc/qemu/virt_riscv/Kconfig"
osource "/home/pavel/.zephyr_ide/external/zephyr/soc/qemu/malta/Kconfig"
osource "/home/pavel/.zephyr_ide/external/zephyr/soc/openisa/rv32m1/Kconfig"
osource "/home/pavel/.zephyr_ide/external/zephyr/soc/openhwgroup/cva6/Kconfig"
osource "/home/pavel/.zephyr_ide/external/zephyr/soc/oct/osd32mp15x/Kconfig"
osource "/home/pavel/.zephyr_ide/external/zephyr/soc/nxp/s32/Kconfig"
osource "/home/pavel/.zephyr_ide/external/zephyr/soc/nxp/rw/Kconfig"
osource "/home/pavel/.zephyr_ide/external/zephyr/soc/nxp/mcx/Kconfig"
osource "/home/pavel/.zephyr_ide/external/zephyr/soc/nxp/lpc/Kconfig"
osource "/home/pavel/.zephyr_ide/external/zephyr/soc/nxp/layerscape/Kconfig"
osource "/home/pavel/.zephyr_ide/external/zephyr/soc/nxp/kinetis/Kconfig"
osource "/home/pavel/.zephyr_ide/external/zephyr/soc/nxp/imxrt/Kconfig"
osource "/home/pavel/.zephyr_ide/external/zephyr/soc/nxp/imx/Kconfig"
osource "/home/pavel/.zephyr_ide/external/zephyr/soc/nuvoton/numicro/Kconfig"
osource "/home/pavel/.zephyr_ide/external/zephyr/soc/nuvoton/numaker/Kconfig"
osource "/home/pavel/.zephyr_ide/external/zephyr/soc/nuvoton/npcx/Kconfig"
osource "/home/pavel/.zephyr_ide/external/zephyr/soc/nuvoton/npcm/Kconfig"
osource "/home/pavel/.zephyr_ide/external/zephyr/soc/nordic/Kconfig"
osource "/home/pavel/.zephyr_ide/external/zephyr/soc/neorv32/Kconfig"
osource "/home/pavel/.zephyr_ide/external/zephyr/soc/native/inf_clock/Kconfig"
osource "/home/pavel/.zephyr_ide/external/zephyr/soc/microchip/sam/Kconfig"
osource "/home/pavel/.zephyr_ide/external/zephyr/soc/microchip/miv/Kconfig"
osource "/home/pavel/.zephyr_ide/external/zephyr/soc/microchip/mec/Kconfig"
osource "/home/pavel/.zephyr_ide/external/zephyr/soc/mediatek/mt8xxx/Kconfig"
osource "/home/pavel/.zephyr_ide/external/zephyr/soc/lowrisc/opentitan/Kconfig"
osource "/home/pavel/.zephyr_ide/external/zephyr/soc/litex/litex_vexriscv/Kconfig"
osource "/home/pavel/.zephyr_ide/external/zephyr/soc/ite/ec/Kconfig"
osource "/home/pavel/.zephyr_ide/external/zephyr/soc/intel/raptor_lake/Kconfig"
osource "/home/pavel/.zephyr_ide/external/zephyr/soc/intel/lakemont/Kconfig"
osource "/home/pavel/.zephyr_ide/external/zephyr/soc/intel/intel_socfpga_std/Kconfig"
osource "/home/pavel/.zephyr_ide/external/zephyr/soc/intel/intel_socfpga/Kconfig"
osource "/home/pavel/.zephyr_ide/external/zephyr/soc/intel/intel_niosv/Kconfig"
osource "/home/pavel/.zephyr_ide/external/zephyr/soc/intel/intel_ish/Kconfig"
osource "/home/pavel/.zephyr_ide/external/zephyr/soc/intel/intel_adsp/Kconfig"
osource "/home/pavel/.zephyr_ide/external/zephyr/soc/intel/elkhart_lake/Kconfig"
osource "/home/pavel/.zephyr_ide/external/zephyr/soc/intel/atom/Kconfig"
osource "/home/pavel/.zephyr_ide/external/zephyr/soc/intel/apollo_lake/Kconfig"
osource "/home/pavel/.zephyr_ide/external/zephyr/soc/intel/alder_lake/Kconfig"
osource "/home/pavel/.zephyr_ide/external/zephyr/soc/infineon/cat3/Kconfig"
osource "/home/pavel/.zephyr_ide/external/zephyr/soc/infineon/cat1c/Kconfig"
osource "/home/pavel/.zephyr_ide/external/zephyr/soc/infineon/cat1b/Kconfig"
osource "/home/pavel/.zephyr_ide/external/zephyr/soc/infineon/cat1a/Kconfig"
osource "/home/pavel/.zephyr_ide/external/zephyr/soc/gd/gd32/Kconfig"
osource "/home/pavel/.zephyr_ide/external/zephyr/soc/gaisler/leon3/Kconfig"
osource "/home/pavel/.zephyr_ide/external/zephyr/soc/gaisler/gr716a/Kconfig"
osource "/home/pavel/.zephyr_ide/external/zephyr/soc/espressif/Kconfig"
osource "/home/pavel/.zephyr_ide/external/zephyr/soc/ene/kb1200/Kconfig"
osource "/home/pavel/.zephyr_ide/external/zephyr/soc/ene/kb106x/Kconfig"
osource "/home/pavel/.zephyr_ide/external/zephyr/soc/efinix/sapphire/Kconfig"
osource "/home/pavel/.zephyr_ide/external/zephyr/soc/cdns/xtensa_sample_controller/Kconfig"
osource "/home/pavel/.zephyr_ide/external/zephyr/soc/cdns/sample_controller32/Kconfig"
osource "/home/pavel/.zephyr_ide/external/zephyr/soc/cdns/dc233c/Kconfig"
osource "/home/pavel/.zephyr_ide/external/zephyr/soc/brcm/bcmvk/Kconfig"
osource "/home/pavel/.zephyr_ide/external/zephyr/soc/brcm/bcm2712/Kconfig"
osource "/home/pavel/.zephyr_ide/external/zephyr/soc/brcm/bcm2711/Kconfig"
osource "/home/pavel/.zephyr_ide/external/zephyr/soc/bflb/Kconfig"
osource "/home/pavel/.zephyr_ide/external/zephyr/soc/atmel/sam0/Kconfig"
osource "/home/pavel/.zephyr_ide/external/zephyr/soc/atmel/sam/Kconfig"
osource "/home/pavel/.zephyr_ide/external/zephyr/soc/aspeed/Kconfig"
osource "/home/pavel/.zephyr_ide/external/zephyr/soc/arm/Kconfig"
osource "/home/pavel/.zephyr_ide/external/zephyr/soc/arm/beetle/Kconfig"
osource "/home/pavel/.zephyr_ide/external/zephyr/soc/antmicro/myra/Kconfig"
osource "/home/pavel/.zephyr_ide/external/zephyr/soc/andestech/Kconfig"
osource "/home/pavel/.zephyr_ide/external/zephyr/soc/amd/acp_6_0/Kconfig"
osource "/home/pavel/.zephyr_ide/external/zephyr/soc/ambiq/Kconfig"
osource "/home/pavel/.zephyr_ide/external/zephyr/soc/aesc/Kconfig"
osource "/home/pavel/.zephyr_ide/external/zephyr/soc/adi/max32/Kconfig"
```
