## FW-LoRaGro/Kconfig
```kconfig
# LoRaGro Library Configuration

config LORAGRO
    bool "LoRaGro Library"
    default y
    help
      Enable LoRaGro measurement library
```

## FW-LoRaGro/common/Kconfig
```kconfig
menu "LoRaGro Fake Drivers"

config LORAGRO_FAKE_DRIVERS
    bool "Enable LoRaGro Fake Driver Library"
    default y

if LORAGRO_FAKE_DRIVERS

rsource "drivers/regulator_fake/Kconfig"
rsource "drivers/sensors/bme280_fake/Kconfig"
rsource "drivers/sensors/bh1750_fake/Kconfig"
rsource "drivers/sensors/scd41_fake/Kconfig"
rsource "drivers/sensors/3in1_soil_fake/Kconfig"
rsource "drivers/lora/Kconfig"

endif

endmenu
```

## FW-LoRaGro/common/drivers/lora/Kconfig
```kconfig
config SX1262_FAKE
    bool "Fake SX1262 LoRa transceiver"
    depends on SPI
    help
      Enables fake SX1262 driver for native simulation.

config SX1262_FAKE_INIT_PRIORITY
    int "Fake SX1262 init priority"
    depends on SX1262_FAKE
    default 60
    help
      Initialization priority for the fake SX1262 driver.
      Should typically be between 40 and 80 (POST_KERNEL).
```

## FW-LoRaGro/common/drivers/regulator_fake/Kconfig
```kconfig
config REGULATOR_P4V_FAKE
    bool "Fake Voltage Regulator"
    depends on REGULATOR
    help
      Fake regulator for native simulation and testing.

config REGULATOR_P4V_FAKE_INIT_PRIORITY
    int "Fake regulator init priority"
    depends on REGULATOR_P4V_FAKE
    default 50
    help
      Initialization priority for the fake regulator.
      Higher values run later. POST_KERNEL devices usually use 40–80.
```

## FW-LoRaGro/common/drivers/sensor_bme280_fake/Kconfig
```kconfig
config SENSOR_P4V_FAKE_BME280
    bool "Fake BME280 sensor (simulation)"
    depends on SENSOR
    default y
	help
	  Fake BME280 sensor driver for native_sim / testing.
	  Provides temperature, humidity and pressure channels.

config SENSOR_P4V_FAKE_BME280_INIT_PRIORITY
    int "Fake BME280 init priority"
    depends on SENSOR_P4V_FAKE_BME280
    default 60
	help
	  Initialization priority for the fake BME280 sensor.
	  POST_KERNEL devices usually use 40–80.
```

## FW-LoRaGro/common/drivers/sensors/3in1_soil_fake/Kconfig
```kconfig
config SOIL_SENSOR_MODBUS_FAKE
    bool "Fake Modbus Soil Sensor"
    depends on REGULATOR
    default n
    help
      Fake Modbus RTU slave for native simulation and testing.

config SOIL_SENSOR_MODBUS_FAKE_INIT_PRIORITY
    int "Fake Modbus RTU init priority"
    depends on SOIL_SENSOR_MODBUS_FAKE
    default 60
    help
      Initialization priority for the fake Modbus Soil Sensor .
      Higher values run later. POST_KERNEL devices usually use 40–80.
```

## FW-LoRaGro/common/drivers/sensors/bh1750_fake/Kconfig
```kconfig
config SENSOR_P4V_BH1750_FAKE
    bool "Fake BH1750 sensor (simulation)"
    depends on SENSOR
    default y
	help
	  Fake BH1750 sensor driver for native_sim / testing.
	  Provides fake light intensity reading.

config SENSOR_P4V_BH1750_FAKE_INIT_PRIORITY
    int "Fake BH1750 init priority"
    depends on SENSOR_P4V_BH1750_FAKE
    default 60
	help
	  Initialization priority for the fake BH1750 sensor.
	  POST_KERNEL devices usually use 40–80.
```

## FW-LoRaGro/common/drivers/sensors/scd41_fake/Kconfig
```kconfig
config SENSOR_P4V_SCD41_FAKE
    bool "Fake SCD41 CO2 Sensor"
    depends on SENSOR
    default y
    help
      Fake SCD41 sensor driver for native_sim / testing.
      Provides CO2 concenttration, temperature and relative humidity.

config SENSOR_P4V_FAKE_SCD41_INIT_PRIORITY
    int "Fake SCD41 init priority"
    depends on SENSOR_P4V_SCD41_FAKE
    default 60
	help
	  Initialization priority for the fake SCD41 sensor.
	  POST_KERNEL devices usually use 40–80.
```

## FW-LoRaGro/common/dts/bindings/lora/p4v,sx1262-fake.yaml
```yaml
description: Fake SX1262 Driver

compatible: "p4v,sx1262-fake"

include:
  - name: "spi-device.yaml"

properties:
  vdd-supply:
    type: phandle
    required: false

  reset-gpios:
    type: phandle-array
    required: false

  busy-gpios:
    type: phandle-array
    required: false

  dio1-gpios:
    type: phandle-array
    required: false

  tx-enable-gpios:
    type: phandle-array
    required: false

  rx-enable-gpios:
    type: phandle-array
    required: false
```

## FW-LoRaGro/common/dts/bindings/regulator/p4v,fake-regulator.yaml
```yaml
description: Fake regulator for simulation

compatible: "p4v,fake-regulator"

include: regulator.yaml
```

## FW-LoRaGro/common/dts/bindings/sensors/p4v,sensor-bh1750-fake .yaml
```yaml
description: Fake BH1750 Light Sensitivity Sensor Driver

compatible: "p4v,sensor-bh1750-fake"

include:
  - name: "sensor-device.yaml"

properties:
  vdd-supply:
    type: phandle
    required: true
```

## FW-LoRaGro/common/dts/bindings/sensors/p4v,sensor-bme280-fake.yaml
```yaml
description: Fake BME280 environmental sensor (simulation)

compatible: "p4v,sensor-bme280-fake"

include:
  - name: sensor-device.yaml

properties:
  vdd-supply:
    type: phandle
    required: true
```

## FW-LoRaGro/common/dts/bindings/sensors/p4v,sensor-scd41-fake.yaml
```yaml
description: Fake SCD41 CO2 concentration sensor (simulation)

compatible: "p4v,sensor-scd41-fake"

include:
  - name: sensor-device.yaml

properties:
  vdd-supply:
    type: phandle
    required: true
```

## FW-LoRaGro/common/dts/bindings/sensors/p4v,sensor-soil3in1-fake.yaml
```yaml
description: P4V soil sensor over Modbus RTU

compatible: "p4v,sensor-soil3in1-fake"

include:
  - name: "sensor-device.yaml"

properties:
  vdd-supply:
    type: phandle
    required: true
    
  slave-address:
    type: int
    required: true
    description: Modbus slave address
```

## FW-LoRaGro/tests/sensors/testcase.yaml
```yaml
tests:
  battery_sense.basic:
    platform_allow: native_sim
    tags: adc_battery

  soil_capacitive_adapter.basic:
    platform_allow: native_sim
    tags: adc_soil

  co2_sensor_adapter.basic:
    platform_allow: native_sim
    tags: co2
```

## FW-LoRaGro/twister-out/native_sim_native/host/power_rail_3v3/power_rail_3v3.basic/Kconfig/Kconfig.modules
```kconfig
menu "acpica (/home/pavel/.zephyr_ide/external/modules/lib/acpica)"
osource "$(ZEPHYR_ACPICA_KCONFIG)"
config ZEPHYR_ACPICA_MODULE
	bool
	default y
endmenu
menu "cmsis (/home/pavel/.zephyr_ide/external/modules/hal/cmsis)"
osource "$(ZEPHYR_CMSIS_KCONFIG)"
config ZEPHYR_CMSIS_MODULE
	bool
	default y
endmenu
menu "cmsis-dsp (/home/pavel/.zephyr_ide/external/modules/lib/cmsis-dsp)"
osource "$(ZEPHYR_CMSIS_DSP_KCONFIG)"
config ZEPHYR_CMSIS_DSP_MODULE
	bool
	default y
endmenu
menu "cmsis-nn (/home/pavel/.zephyr_ide/external/modules/lib/cmsis-nn)"
osource "$(ZEPHYR_CMSIS_NN_KCONFIG)"
config ZEPHYR_CMSIS_NN_MODULE
	bool
	default y
endmenu
menu "cmsis_6 (/home/pavel/.zephyr_ide/external/modules/hal/cmsis_6)"
osource "$(ZEPHYR_CMSIS_6_KCONFIG)"
config ZEPHYR_CMSIS_6_MODULE
	bool
	default y
endmenu
menu "fatfs (/home/pavel/.zephyr_ide/external/modules/fs/fatfs)"
osource "$(ZEPHYR_FATFS_KCONFIG)"
config ZEPHYR_FATFS_MODULE
	bool
	default y
endmenu
config ZEPHYR_ADI_MODULE
	bool
	default y
menu "hal_afbr (/home/pavel/.zephyr_ide/external/modules/hal/afbr)"
osource "$(ZEPHYR_HAL_AFBR_KCONFIG)"
config ZEPHYR_HAL_AFBR_MODULE
	bool
	default y

config ZEPHYR_HAL_AFBR_MODULE_BLOBS
	bool
endmenu
menu "hal_ambiq (/home/pavel/.zephyr_ide/external/modules/hal/ambiq)"
osource "$(ZEPHYR_HAL_AMBIQ_KCONFIG)"
config ZEPHYR_HAL_AMBIQ_MODULE
	bool
	default y
endmenu
config ZEPHYR_ATMEL_MODULE
	bool
	default y
menu "hal_bouffalolab (/home/pavel/.zephyr_ide/external/modules/hal/bouffalolab)"
osource "$(ZEPHYR_HAL_BOUFFALOLAB_KCONFIG)"
config ZEPHYR_HAL_BOUFFALOLAB_MODULE
	bool
	default y
endmenu
menu "hal_espressif (/home/pavel/.zephyr_ide/external/modules/hal/espressif)"
osource "/home/pavel/.zephyr_ide/external/modules/hal/espressif/zephyr/Kconfig"
config ZEPHYR_HAL_ESPRESSIF_MODULE
	bool
	default y

config ZEPHYR_HAL_ESPRESSIF_MODULE_BLOBS
	bool
endmenu
menu "hal_ethos_u (/home/pavel/.zephyr_ide/external/modules/hal/ethos_u)"
osource "$(ZEPHYR_HAL_ETHOS_U_KCONFIG)"
config ZEPHYR_HAL_ETHOS_U_MODULE
	bool
	default y
endmenu
menu "hal_gigadevice (/home/pavel/.zephyr_ide/external/modules/hal/gigadevice)"
osource "$(ZEPHYR_HAL_GIGADEVICE_KCONFIG)"
config ZEPHYR_HAL_GIGADEVICE_MODULE
	bool
	default y
endmenu
menu "hal_infineon (/home/pavel/.zephyr_ide/external/modules/hal/infineon)"
osource "$(ZEPHYR_HAL_INFINEON_KCONFIG)"
config ZEPHYR_HAL_INFINEON_MODULE
	bool
	default y

config ZEPHYR_HAL_INFINEON_MODULE_BLOBS
	bool
endmenu
menu "hal_intel (/home/pavel/.zephyr_ide/external/modules/hal/intel)"
osource "/home/pavel/.zephyr_ide/external/modules/hal/intel/zephyr/Kconfig"
config ZEPHYR_HAL_INTEL_MODULE
	bool
	default y
endmenu
config ZEPHYR_MICROCHIP_MODULE
	bool
	default y
menu "hal_nordic (/home/pavel/.zephyr_ide/external/modules/hal/nordic)"
osource "$(ZEPHYR_HAL_NORDIC_KCONFIG)"
config ZEPHYR_HAL_NORDIC_MODULE
	bool
	default y

config ZEPHYR_HAL_NORDIC_MODULE_BLOBS
	bool
endmenu
config ZEPHYR_NUVOTON_MODULE
	bool
	default y
menu "hal_nxp (/home/pavel/.zephyr_ide/external/modules/hal/nxp)"
osource "$(ZEPHYR_HAL_NXP_KCONFIG)"
config ZEPHYR_HAL_NXP_MODULE
	bool
	default y

config ZEPHYR_HAL_NXP_MODULE_BLOBS
	bool
endmenu
config ZEPHYR_OPENISA_MODULE
	bool
	default y
config ZEPHYR_QUICKLOGIC_MODULE
	bool
	default y
config ZEPHYR_HAL_RENESAS_MODULE
	bool
	default y

config ZEPHYR_HAL_RENESAS_MODULE_BLOBS
	bool
menu "hal_rpi_pico (/home/pavel/.zephyr_ide/external/modules/hal/rpi_pico)"
osource "$(ZEPHYR_HAL_RPI_PICO_KCONFIG)"
config ZEPHYR_HAL_RPI_PICO_MODULE
	bool
	default y
endmenu
menu "hal_silabs (/home/pavel/.zephyr_ide/external/modules/hal/silabs)"
osource "$(ZEPHYR_HAL_SILABS_KCONFIG)"
config ZEPHYR_HAL_SILABS_MODULE
	bool
	default y

config ZEPHYR_HAL_SILABS_MODULE_BLOBS
	bool
endmenu
menu "hal_st (/home/pavel/.zephyr_ide/external/modules/hal/st)"
osource "$(ZEPHYR_HAL_ST_KCONFIG)"
config ZEPHYR_HAL_ST_MODULE
	bool
	default y
endmenu
config ZEPHYR_HAL_STM32_MODULE
	bool
	default y

config ZEPHYR_HAL_STM32_MODULE_BLOBS
	bool
menu "hal_tdk (/home/pavel/.zephyr_ide/external/modules/hal/tdk)"
osource "$(ZEPHYR_HAL_TDK_KCONFIG)"
config ZEPHYR_HAL_TDK_MODULE
	bool
	default y
endmenu
menu "hal_telink (/home/pavel/.zephyr_ide/external/modules/hal/telink)"
osource "/home/pavel/.zephyr_ide/external/modules/hal/telink/Kconfig"
config ZEPHYR_HAL_TELINK_MODULE
	bool
	default y
endmenu
config ZEPHYR_TI_MODULE
	bool
	default y
menu "hal_wch (/home/pavel/.zephyr_ide/external/modules/hal/wch)"
osource "$(ZEPHYR_HAL_WCH_KCONFIG)"
config ZEPHYR_HAL_WCH_MODULE
	bool
	default y
endmenu
config ZEPHYR_HAL_WURTHELEKTRONIK_MODULE
	bool
	default y
config ZEPHYR_XTENSA_MODULE
	bool
	default y
menu "hostap (/home/pavel/.zephyr_ide/external/modules/lib/hostap)"
osource "$(ZEPHYR_HOSTAP_KCONFIG)"
config ZEPHYR_HOSTAP_MODULE
	bool
	default y
endmenu
menu "liblc3 (/home/pavel/.zephyr_ide/external/modules/lib/liblc3)"
osource "$(ZEPHYR_LIBLC3_KCONFIG)"
config ZEPHYR_LIBLC3_MODULE
	bool
	default y
endmenu
config ZEPHYR_LIBMCTP_MODULE
	bool
	default y
config ZEPHYR_LIBMETAL_MODULE
	bool
	default y
menu "littlefs (/home/pavel/.zephyr_ide/external/modules/fs/littlefs)"
osource "$(ZEPHYR_LITTLEFS_KCONFIG)"
config ZEPHYR_LITTLEFS_MODULE
	bool
	default y
endmenu
menu "loramac-node (/home/pavel/.zephyr_ide/external/modules/lib/loramac-node)"
osource "$(ZEPHYR_LORAMAC_NODE_KCONFIG)"
config ZEPHYR_LORAMAC_NODE_MODULE
	bool
	default y
endmenu
menu "lvgl (/home/pavel/.zephyr_ide/external/modules/lib/gui/lvgl)"
osource "/home/pavel/.zephyr_ide/external/modules/lib/gui/lvgl/zephyr/Kconfig"
config ZEPHYR_LVGL_MODULE
	bool
	default y
endmenu
menu "mbedtls (/home/pavel/.zephyr_ide/external/modules/crypto/mbedtls)"
osource "$(ZEPHYR_MBEDTLS_KCONFIG)"
config ZEPHYR_MBEDTLS_MODULE
	bool
	default y
endmenu
config ZEPHYR_MCUBOOT_MODULE
	bool
	default y
config ZEPHYR_MIPI_SYS_T_MODULE
	bool
	default y
menu "nrf_wifi (/home/pavel/.zephyr_ide/external/modules/lib/nrf_wifi)"
osource "$(ZEPHYR_NRF_WIFI_KCONFIG)"
config ZEPHYR_NRF_WIFI_MODULE
	bool
	default y

config ZEPHYR_NRF_WIFI_MODULE_BLOBS
	bool
endmenu
config ZEPHYR_OPEN_AMP_MODULE
	bool
	default y
menu "openthread (/home/pavel/.zephyr_ide/external/modules/lib/openthread)"
osource "$(ZEPHYR_OPENTHREAD_KCONFIG)"
config ZEPHYR_OPENTHREAD_MODULE
	bool
	default y
endmenu
menu "percepio (/home/pavel/.zephyr_ide/external/modules/debug/percepio)"
osource "/home/pavel/.zephyr_ide/external/modules/debug/percepio/zephyr/Kconfig"
config ZEPHYR_PERCEPIO_MODULE
	bool
	default y
endmenu
menu "picolibc (/home/pavel/.zephyr_ide/external/modules/lib/picolibc)"
osource "/home/pavel/.zephyr_ide/external/modules/lib/picolibc/zephyr/Kconfig"
config ZEPHYR_PICOLIBC_MODULE
	bool
	default y
endmenu
menu "segger (/home/pavel/.zephyr_ide/external/modules/debug/segger)"
osource "$(ZEPHYR_SEGGER_KCONFIG)"
config ZEPHYR_SEGGER_MODULE
	bool
	default y
endmenu
config ZEPHYR_TINYCRYPT_MODULE
	bool
	default y
menu "trusted-firmware-a (/home/pavel/.zephyr_ide/external/modules/tee/tf-a/trusted-firmware-a)"
osource "$(ZEPHYR_TRUSTED_FIRMWARE_A_KCONFIG)"
config ZEPHYR_TRUSTED_FIRMWARE_A_MODULE
	bool
	default y
endmenu
menu "trusted-firmware-m (/home/pavel/.zephyr_ide/external/modules/tee/tf-m/trusted-firmware-m)"
osource "$(ZEPHYR_TRUSTED_FIRMWARE_M_KCONFIG)"
config ZEPHYR_TRUSTED_FIRMWARE_M_MODULE
	bool
	default y
endmenu
menu "uoscore-uedhoc (/home/pavel/.zephyr_ide/external/modules/lib/uoscore-uedhoc)"
osource "$(ZEPHYR_UOSCORE_UEDHOC_KCONFIG)"
config ZEPHYR_UOSCORE_UEDHOC_MODULE
	bool
	default y
endmenu
menu "zcbor (/home/pavel/.zephyr_ide/external/modules/lib/zcbor)"
osource "$(ZEPHYR_ZCBOR_KCONFIG)"
config ZEPHYR_ZCBOR_MODULE
	bool
	default y
endmenu
config ZEPHYR_NRF_HW_MODELS_MODULE
	bool
	default y
```
